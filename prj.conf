## CMakeLists.txt
```
cmake_minimum_required(VERSION 3.13.1)

set (CMAKE_CXX_STANDARD 20)

list(APPEND ZEPHYR_EXTRA_MODULES ${CMAKE_CURRENT_SOURCE_DIR}/dependencies/MyZephyrLibrary/module)

find_package(Zephyr REQUIRED HINTS $ENV{ZEPHYR_BASE})
project(ZephyrLibraryUsage)

target_sources(app PRIVATE src/main.cpp)

target_include_directories(app PRIVATE include)
```

## prj.conf
```kconfig
CONFIG_CPLUSPLUS=y
CONFIG_STD_CPP2A=y
CONFIG_MINIMAL_LIBC_MALLOC_ARENA_SIZE=128
CONFIG_NEWLIB_LIBC=y
CONFIG_LIB_CPLUSPLUS=y
CONFIG_RTT_CONSOLE=y
```

## src/main.cpp
```c
#include "MyZephyrLibrary.h"

#include <string>
#include <cstdio>

void main()
{
	auto message = std::string("Hello There");

	auto myClass = MyZephyrClass(message);

	myClass.printMessage();

	printf("Done!\n");
}
```
